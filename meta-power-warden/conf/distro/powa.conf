## meta-power-warden/conf/distro/powa.conf
```bitbake
DISTRO = "powa"
DISTRO_NAME = "Powa (Power Warden Distribution)"
DISTRO_VERSION = "1.0"

MAINTAINER = "Julian Rodriguez <junirodriguezz1@gmail.com>"

# Enable systemd here:  https://docs.yoctoproject.org/dev/dev-manual/init-manager.html#selecting-an-initialization-manager
# Also check: https://github.com/yoctoproject/poky/blob/d8b0adfaac9118777d099f76c428e088da519ff0/meta/conf/distro/include/init-manager-systemd.inc
INIT_MANAGER = "systemd"

# Just copying poky for preferred versions
PREFERRED_VERSION_linux-yocto ?= "6.12%"
PREFERRED_VERSION_linux-yocto-rt ?= "6.12%"
```
